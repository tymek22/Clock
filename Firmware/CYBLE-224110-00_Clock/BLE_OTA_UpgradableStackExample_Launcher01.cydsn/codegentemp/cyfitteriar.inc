;
; File Name: cyfitteriar.inc
; 
; PSoC Creator  4.1 Update 1
;
; Description:
; 
;
;-------------------------------------------------------------------------------
; Copyright (c) 2007-2017 Cypress Semiconductor.  All rights reserved.
; You may use this file only in accordance with the license, terms, conditions, 
; disclaimers, and limitations in the end user license agreement accompanying 
; the software package with which this file was provided.
;-------------------------------------------------------------------------------

#ifndef INCLUDED_CYFITTERIAR_INC
#define INCLUDED_CYFITTERIAR_INC
    INCLUDE cydeviceiar_trm.inc

/* L_LED */
L_LED__0__DR EQU CYREG_GPIO_PRT3_DR
L_LED__0__DR_CLR EQU CYREG_GPIO_PRT3_DR_CLR
L_LED__0__DR_INV EQU CYREG_GPIO_PRT3_DR_INV
L_LED__0__DR_SET EQU CYREG_GPIO_PRT3_DR_SET
L_LED__0__HSIOM EQU CYREG_HSIOM_PORT_SEL3
L_LED__0__HSIOM_MASK EQU 0xF0000000
L_LED__0__HSIOM_SHIFT EQU 28
L_LED__0__INTCFG EQU CYREG_GPIO_PRT3_INTR_CFG
L_LED__0__INTR EQU CYREG_GPIO_PRT3_INTR
L_LED__0__INTR_CFG EQU CYREG_GPIO_PRT3_INTR_CFG
L_LED__0__INTSTAT EQU CYREG_GPIO_PRT3_INTR
L_LED__0__MASK EQU 0x80
L_LED__0__PA__CFG0 EQU CYREG_UDB_PA3_CFG0
L_LED__0__PA__CFG1 EQU CYREG_UDB_PA3_CFG1
L_LED__0__PA__CFG10 EQU CYREG_UDB_PA3_CFG10
L_LED__0__PA__CFG11 EQU CYREG_UDB_PA3_CFG11
L_LED__0__PA__CFG12 EQU CYREG_UDB_PA3_CFG12
L_LED__0__PA__CFG13 EQU CYREG_UDB_PA3_CFG13
L_LED__0__PA__CFG14 EQU CYREG_UDB_PA3_CFG14
L_LED__0__PA__CFG2 EQU CYREG_UDB_PA3_CFG2
L_LED__0__PA__CFG3 EQU CYREG_UDB_PA3_CFG3
L_LED__0__PA__CFG4 EQU CYREG_UDB_PA3_CFG4
L_LED__0__PA__CFG5 EQU CYREG_UDB_PA3_CFG5
L_LED__0__PA__CFG6 EQU CYREG_UDB_PA3_CFG6
L_LED__0__PA__CFG7 EQU CYREG_UDB_PA3_CFG7
L_LED__0__PA__CFG8 EQU CYREG_UDB_PA3_CFG8
L_LED__0__PA__CFG9 EQU CYREG_UDB_PA3_CFG9
L_LED__0__PC EQU CYREG_GPIO_PRT3_PC
L_LED__0__PC2 EQU CYREG_GPIO_PRT3_PC2
L_LED__0__PORT EQU 3
L_LED__0__PS EQU CYREG_GPIO_PRT3_PS
L_LED__0__SHIFT EQU 7
L_LED__DR EQU CYREG_GPIO_PRT3_DR
L_LED__DR_CLR EQU CYREG_GPIO_PRT3_DR_CLR
L_LED__DR_INV EQU CYREG_GPIO_PRT3_DR_INV
L_LED__DR_SET EQU CYREG_GPIO_PRT3_DR_SET
L_LED__INTCFG EQU CYREG_GPIO_PRT3_INTR_CFG
L_LED__INTR EQU CYREG_GPIO_PRT3_INTR
L_LED__INTR_CFG EQU CYREG_GPIO_PRT3_INTR_CFG
L_LED__INTSTAT EQU CYREG_GPIO_PRT3_INTR
L_LED__MASK EQU 0x80
L_LED__PA__CFG0 EQU CYREG_UDB_PA3_CFG0
L_LED__PA__CFG1 EQU CYREG_UDB_PA3_CFG1
L_LED__PA__CFG10 EQU CYREG_UDB_PA3_CFG10
L_LED__PA__CFG11 EQU CYREG_UDB_PA3_CFG11
L_LED__PA__CFG12 EQU CYREG_UDB_PA3_CFG12
L_LED__PA__CFG13 EQU CYREG_UDB_PA3_CFG13
L_LED__PA__CFG14 EQU CYREG_UDB_PA3_CFG14
L_LED__PA__CFG2 EQU CYREG_UDB_PA3_CFG2
L_LED__PA__CFG3 EQU CYREG_UDB_PA3_CFG3
L_LED__PA__CFG4 EQU CYREG_UDB_PA3_CFG4
L_LED__PA__CFG5 EQU CYREG_UDB_PA3_CFG5
L_LED__PA__CFG6 EQU CYREG_UDB_PA3_CFG6
L_LED__PA__CFG7 EQU CYREG_UDB_PA3_CFG7
L_LED__PA__CFG8 EQU CYREG_UDB_PA3_CFG8
L_LED__PA__CFG9 EQU CYREG_UDB_PA3_CFG9
L_LED__PC EQU CYREG_GPIO_PRT3_PC
L_LED__PC2 EQU CYREG_GPIO_PRT3_PC2
L_LED__PORT EQU 3
L_LED__PS EQU CYREG_GPIO_PRT3_PS
L_LED__SHIFT EQU 7

/* UART_tx */
UART_tx__0__DR EQU CYREG_GPIO_PRT1_DR
UART_tx__0__DR_CLR EQU CYREG_GPIO_PRT1_DR_CLR
UART_tx__0__DR_INV EQU CYREG_GPIO_PRT1_DR_INV
UART_tx__0__DR_SET EQU CYREG_GPIO_PRT1_DR_SET
UART_tx__0__HSIOM EQU CYREG_HSIOM_PORT_SEL1
UART_tx__0__HSIOM_MASK EQU 0x00F00000
UART_tx__0__HSIOM_SHIFT EQU 20
UART_tx__0__INTCFG EQU CYREG_GPIO_PRT1_INTR_CFG
UART_tx__0__INTR EQU CYREG_GPIO_PRT1_INTR
UART_tx__0__INTR_CFG EQU CYREG_GPIO_PRT1_INTR_CFG
UART_tx__0__INTSTAT EQU CYREG_GPIO_PRT1_INTR
UART_tx__0__MASK EQU 0x20
UART_tx__0__PA__CFG0 EQU CYREG_UDB_PA1_CFG0
UART_tx__0__PA__CFG1 EQU CYREG_UDB_PA1_CFG1
UART_tx__0__PA__CFG10 EQU CYREG_UDB_PA1_CFG10
UART_tx__0__PA__CFG11 EQU CYREG_UDB_PA1_CFG11
UART_tx__0__PA__CFG12 EQU CYREG_UDB_PA1_CFG12
UART_tx__0__PA__CFG13 EQU CYREG_UDB_PA1_CFG13
UART_tx__0__PA__CFG14 EQU CYREG_UDB_PA1_CFG14
UART_tx__0__PA__CFG2 EQU CYREG_UDB_PA1_CFG2
UART_tx__0__PA__CFG3 EQU CYREG_UDB_PA1_CFG3
UART_tx__0__PA__CFG4 EQU CYREG_UDB_PA1_CFG4
UART_tx__0__PA__CFG5 EQU CYREG_UDB_PA1_CFG5
UART_tx__0__PA__CFG6 EQU CYREG_UDB_PA1_CFG6
UART_tx__0__PA__CFG7 EQU CYREG_UDB_PA1_CFG7
UART_tx__0__PA__CFG8 EQU CYREG_UDB_PA1_CFG8
UART_tx__0__PA__CFG9 EQU CYREG_UDB_PA1_CFG9
UART_tx__0__PC EQU CYREG_GPIO_PRT1_PC
UART_tx__0__PC2 EQU CYREG_GPIO_PRT1_PC2
UART_tx__0__PORT EQU 1
UART_tx__0__PS EQU CYREG_GPIO_PRT1_PS
UART_tx__0__SHIFT EQU 5
UART_tx__DR EQU CYREG_GPIO_PRT1_DR
UART_tx__DR_CLR EQU CYREG_GPIO_PRT1_DR_CLR
UART_tx__DR_INV EQU CYREG_GPIO_PRT1_DR_INV
UART_tx__DR_SET EQU CYREG_GPIO_PRT1_DR_SET
UART_tx__INTCFG EQU CYREG_GPIO_PRT1_INTR_CFG
UART_tx__INTR EQU CYREG_GPIO_PRT1_INTR
UART_tx__INTR_CFG EQU CYREG_GPIO_PRT1_INTR_CFG
UART_tx__INTSTAT EQU CYREG_GPIO_PRT1_INTR
UART_tx__MASK EQU 0x20
UART_tx__PA__CFG0 EQU CYREG_UDB_PA1_CFG0
UART_tx__PA__CFG1 EQU CYREG_UDB_PA1_CFG1
UART_tx__PA__CFG10 EQU CYREG_UDB_PA1_CFG10
UART_tx__PA__CFG11 EQU CYREG_UDB_PA1_CFG11
UART_tx__PA__CFG12 EQU CYREG_UDB_PA1_CFG12
UART_tx__PA__CFG13 EQU CYREG_UDB_PA1_CFG13
UART_tx__PA__CFG14 EQU CYREG_UDB_PA1_CFG14
UART_tx__PA__CFG2 EQU CYREG_UDB_PA1_CFG2
UART_tx__PA__CFG3 EQU CYREG_UDB_PA1_CFG3
UART_tx__PA__CFG4 EQU CYREG_UDB_PA1_CFG4
UART_tx__PA__CFG5 EQU CYREG_UDB_PA1_CFG5
UART_tx__PA__CFG6 EQU CYREG_UDB_PA1_CFG6
UART_tx__PA__CFG7 EQU CYREG_UDB_PA1_CFG7
UART_tx__PA__CFG8 EQU CYREG_UDB_PA1_CFG8
UART_tx__PA__CFG9 EQU CYREG_UDB_PA1_CFG9
UART_tx__PC EQU CYREG_GPIO_PRT1_PC
UART_tx__PC2 EQU CYREG_GPIO_PRT1_PC2
UART_tx__PORT EQU 1
UART_tx__PS EQU CYREG_GPIO_PRT1_PS
UART_tx__SHIFT EQU 5

/* Miscellaneous */
CYDEV_BCLK__HFCLK__HZ EQU 48000000
CYDEV_BCLK__HFCLK__KHZ EQU 48000
CYDEV_BCLK__HFCLK__MHZ EQU 48
CYDEV_BCLK__SYSCLK__HZ EQU 24000000
CYDEV_BCLK__SYSCLK__KHZ EQU 24000
CYDEV_BCLK__SYSCLK__MHZ EQU 24
CYDEV_BOOTLOADER_APPLICATIONS EQU 2
CYDEV_BOOTLOADER_CHECKSUM_BASIC EQU 0
CYDEV_BOOTLOADER_CHECKSUM_CRC EQU 1
CYDEV_BOOTLOADER_IO_COMP_CUSTOM_IO EQU 0
CyBtldr_Custom_Interface EQU CYDEV_BOOTLOADER_IO_COMP_CUSTOM_IO
CYDEV_BOOTLOADER_IO_COMP_LAUNCHER_ONLY EQU 1
CyBtldr_LAUNCHER_ONLY EQU CYDEV_BOOTLOADER_IO_COMP_LAUNCHER_ONLY
CYDEV_BOOTLOADER_IO_COMP EQU CYDEV_BOOTLOADER_IO_COMP_LAUNCHER_ONLY
CYDEV_CHIP_DIE_LEOPARD EQU 1
CYDEV_CHIP_DIE_PSOC4A EQU 16
CYDEV_CHIP_DIE_PSOC5LP EQU 2
CYDEV_CHIP_DIE_PSOC5TM EQU 3
CYDEV_CHIP_DIE_TMA4 EQU 4
CYDEV_CHIP_DIE_UNKNOWN EQU 0
CYDEV_CHIP_FAMILY_FM0P EQU 5
CYDEV_CHIP_FAMILY_FM3 EQU 6
CYDEV_CHIP_FAMILY_FM4 EQU 7
CYDEV_CHIP_FAMILY_PSOC3 EQU 1
CYDEV_CHIP_FAMILY_PSOC4 EQU 2
CYDEV_CHIP_FAMILY_PSOC5 EQU 3
CYDEV_CHIP_FAMILY_PSOC6 EQU 4
CYDEV_CHIP_FAMILY_UNKNOWN EQU 0
CYDEV_CHIP_FAMILY_USED EQU CYDEV_CHIP_FAMILY_PSOC4
CYDEV_CHIP_JTAG_ID EQU 0x135311A3
CYDEV_CHIP_MEMBER_3A EQU 1
CYDEV_CHIP_MEMBER_4A EQU 16
CYDEV_CHIP_MEMBER_4D EQU 12
CYDEV_CHIP_MEMBER_4E EQU 6
CYDEV_CHIP_MEMBER_4F EQU 17
CYDEV_CHIP_MEMBER_4G EQU 4
CYDEV_CHIP_MEMBER_4H EQU 15
CYDEV_CHIP_MEMBER_4I EQU 21
CYDEV_CHIP_MEMBER_4J EQU 13
CYDEV_CHIP_MEMBER_4K EQU 14
CYDEV_CHIP_MEMBER_4L EQU 20
CYDEV_CHIP_MEMBER_4M EQU 19
CYDEV_CHIP_MEMBER_4N EQU 9
CYDEV_CHIP_MEMBER_4O EQU 7
CYDEV_CHIP_MEMBER_4P EQU 18
CYDEV_CHIP_MEMBER_4Q EQU 11
CYDEV_CHIP_MEMBER_4R EQU 8
CYDEV_CHIP_MEMBER_4S EQU 10
CYDEV_CHIP_MEMBER_4U EQU 5
CYDEV_CHIP_MEMBER_5A EQU 3
CYDEV_CHIP_MEMBER_5B EQU 2
CYDEV_CHIP_MEMBER_6A EQU 22
CYDEV_CHIP_MEMBER_FM3 EQU 26
CYDEV_CHIP_MEMBER_FM4 EQU 27
CYDEV_CHIP_MEMBER_PDL_FM0P_TYPE1 EQU 23
CYDEV_CHIP_MEMBER_PDL_FM0P_TYPE2 EQU 24
CYDEV_CHIP_MEMBER_PDL_FM0P_TYPE3 EQU 25
CYDEV_CHIP_MEMBER_UNKNOWN EQU 0
CYDEV_CHIP_MEMBER_USED EQU CYDEV_CHIP_MEMBER_4F
CYDEV_CHIP_DIE_EXPECT EQU CYDEV_CHIP_MEMBER_USED
CYDEV_CHIP_DIE_ACTUAL EQU CYDEV_CHIP_DIE_EXPECT
CYDEV_CHIP_REV_LEOPARD_ES1 EQU 0
CYDEV_CHIP_REV_LEOPARD_ES2 EQU 1
CYDEV_CHIP_REV_LEOPARD_ES3 EQU 3
CYDEV_CHIP_REV_LEOPARD_PRODUCTION EQU 3
CYDEV_CHIP_REV_PSOC4A_ES0 EQU 17
CYDEV_CHIP_REV_PSOC4A_PRODUCTION EQU 17
CYDEV_CHIP_REV_PSOC5LP_ES0 EQU 0
CYDEV_CHIP_REV_PSOC5LP_PRODUCTION EQU 0
CYDEV_CHIP_REV_PSOC5TM_ES0 EQU 0
CYDEV_CHIP_REV_PSOC5TM_ES1 EQU 1
CYDEV_CHIP_REV_PSOC5TM_PRODUCTION EQU 1
CYDEV_CHIP_REV_TMA4_ES EQU 17
CYDEV_CHIP_REV_TMA4_ES2 EQU 33
CYDEV_CHIP_REV_TMA4_PRODUCTION EQU 17
CYDEV_CHIP_REVISION_3A_ES1 EQU 0
CYDEV_CHIP_REVISION_3A_ES2 EQU 1
CYDEV_CHIP_REVISION_3A_ES3 EQU 3
CYDEV_CHIP_REVISION_3A_PRODUCTION EQU 3
CYDEV_CHIP_REVISION_4A_ES0 EQU 17
CYDEV_CHIP_REVISION_4A_PRODUCTION EQU 17
CYDEV_CHIP_REVISION_4D_PRODUCTION EQU 0
CYDEV_CHIP_REVISION_4E_PRODUCTION EQU 0
CYDEV_CHIP_REVISION_4F_PRODUCTION EQU 0
CYDEV_CHIP_REVISION_4F_PRODUCTION_256DMA EQU 0
CYDEV_CHIP_REVISION_4F_PRODUCTION_256K EQU 0
CYDEV_CHIP_REVISION_4G_ES EQU 17
CYDEV_CHIP_REVISION_4G_ES2 EQU 33
CYDEV_CHIP_REVISION_4G_PRODUCTION EQU 17
CYDEV_CHIP_REVISION_4H_PRODUCTION EQU 0
CYDEV_CHIP_REVISION_4I_PRODUCTION EQU 0
CYDEV_CHIP_REVISION_4J_PRODUCTION EQU 0
CYDEV_CHIP_REVISION_4K_PRODUCTION EQU 0
CYDEV_CHIP_REVISION_4L_PRODUCTION EQU 0
CYDEV_CHIP_REVISION_4M_PRODUCTION EQU 0
CYDEV_CHIP_REVISION_4N_PRODUCTION EQU 0
CYDEV_CHIP_REVISION_4O_PRODUCTION EQU 0
CYDEV_CHIP_REVISION_4P_PRODUCTION EQU 0
CYDEV_CHIP_REVISION_4Q_PRODUCTION EQU 0
CYDEV_CHIP_REVISION_4R_PRODUCTION EQU 0
CYDEV_CHIP_REVISION_4S_PRODUCTION EQU 0
CYDEV_CHIP_REVISION_4U_PRODUCTION EQU 0
CYDEV_CHIP_REVISION_5A_ES0 EQU 0
CYDEV_CHIP_REVISION_5A_ES1 EQU 1
CYDEV_CHIP_REVISION_5A_PRODUCTION EQU 1
CYDEV_CHIP_REVISION_5B_ES0 EQU 0
CYDEV_CHIP_REVISION_5B_PRODUCTION EQU 0
CYDEV_CHIP_REVISION_6A_NO_UDB EQU 0
CYDEV_CHIP_REVISION_6A_PRODUCTION EQU 0
CYDEV_CHIP_REVISION_FM3_PRODUCTION EQU 0
CYDEV_CHIP_REVISION_FM4_PRODUCTION EQU 0
CYDEV_CHIP_REVISION_PDL_FM0P_TYPE1_PRODUCTION EQU 0
CYDEV_CHIP_REVISION_PDL_FM0P_TYPE2_PRODUCTION EQU 0
CYDEV_CHIP_REVISION_PDL_FM0P_TYPE3_PRODUCTION EQU 0
CYDEV_CHIP_REVISION_USED EQU CYDEV_CHIP_REVISION_4F_PRODUCTION_256K
CYDEV_CHIP_REV_EXPECT EQU CYDEV_CHIP_REVISION_USED
CYDEV_CONFIG_READ_ACCELERATOR EQU 1
CYDEV_CONFIG_UNUSED_IO_AllowButWarn EQU 0
CYDEV_CONFIG_UNUSED_IO EQU CYDEV_CONFIG_UNUSED_IO_AllowButWarn
CYDEV_CONFIG_UNUSED_IO_AllowWithInfo EQU 1
CYDEV_CONFIG_UNUSED_IO_Disallowed EQU 2
CYDEV_CONFIGURATION_COMPRESSED EQU 1
CYDEV_CONFIGURATION_MODE_COMPRESSED EQU 0
CYDEV_CONFIGURATION_MODE EQU CYDEV_CONFIGURATION_MODE_COMPRESSED
CYDEV_CONFIGURATION_MODE_DMA EQU 2
CYDEV_CONFIGURATION_MODE_UNCOMPRESSED EQU 1
CYDEV_DEBUG_PROTECT_KILL EQU 4
CYDEV_DEBUG_PROTECT_OPEN EQU 1
CYDEV_DEBUG_PROTECT EQU CYDEV_DEBUG_PROTECT_OPEN
CYDEV_DEBUG_PROTECT_PROTECTED EQU 2
CYDEV_DEBUGGING_DPS_Disable EQU 3
CYDEV_DEBUGGING_DPS_SWD EQU 2
CYDEV_DEBUGGING_DPS EQU CYDEV_DEBUGGING_DPS_SWD
CYDEV_DEBUGGING_ENABLE EQU 1
CYDEV_DFT_SELECT_CLK0 EQU 10
CYDEV_DFT_SELECT_CLK1 EQU 11
CYDEV_HEAP_SIZE EQU 0x200
CYDEV_IMO_TRIMMED_BY_USB EQU 0
CYDEV_IMO_TRIMMED_BY_WCO EQU 0
CYDEV_IS_EXPORTING_CODE EQU 0
CYDEV_IS_IMPORTING_CODE EQU 0
CYDEV_PROJ_TYPE EQU 5
CYDEV_PROJ_TYPE_BOOTLOADER EQU 1
CYDEV_PROJ_TYPE_LAUNCHER EQU 5
CYDEV_PROJ_TYPE_LOADABLE EQU 2
CYDEV_PROJ_TYPE_LOADABLEANDBOOTLOADER EQU 4
CYDEV_PROJ_TYPE_MULTIAPPBOOTLOADER EQU 3
CYDEV_PROJ_TYPE_STANDARD EQU 0
CYDEV_STACK_SIZE EQU 0x0800
CYDEV_USE_BUNDLED_CMSIS EQU 1
CYDEV_VARIABLE_VDDA EQU 1
CYDEV_VDD_MV EQU 3300
CYDEV_VDDA_MV EQU 3300
CYDEV_VDDR_MV EQU 3300
CYDEV_WDT_GENERATE_ISR EQU 1
CYIPBLOCK_m0s8bless_VERSION EQU 1
CYIPBLOCK_m0s8cpussv2_VERSION EQU 1
CYIPBLOCK_m0s8csd_VERSION EQU 1
CYIPBLOCK_m0s8ioss_VERSION EQU 1
CYIPBLOCK_m0s8lcd_VERSION EQU 2
CYIPBLOCK_m0s8lpcomp_VERSION EQU 2
CYIPBLOCK_m0s8peri_VERSION EQU 1
CYIPBLOCK_m0s8scb_VERSION EQU 2
CYIPBLOCK_m0s8srssv2_VERSION EQU 1
CYIPBLOCK_m0s8tcpwm_VERSION EQU 2
CYIPBLOCK_m0s8udbif_VERSION EQU 1
CYIPBLOCK_s8pass4al_VERSION EQU 1
CYDEV_BOOTLOADER_ENABLE EQU 1

#endif /* INCLUDED_CYFITTERIAR_INC */
