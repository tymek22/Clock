/*******************************************************************************
* File Name: cyfittergnu.inc
* 
* PSoC Creator  4.1 Update 1
*
* Description:
* 
* This file is automatically generated by PSoC Creator.
*
********************************************************************************
* Copyright (c) 2007-2017 Cypress Semiconductor.  All rights reserved.
* You may use this file only in accordance with the license, terms, conditions, 
* disclaimers, and limitations in the end user license agreement accompanying 
* the software package with which this file was provided.
********************************************************************************/

.ifndef INCLUDED_CYFITTERGNU_INC
.set INCLUDED_CYFITTERGNU_INC, 1
.include "cydevicegnu_trm.inc"

/* CPS */
.set CPS__0__DR, CYREG_GPIO_PRT0_DR
.set CPS__0__DR_CLR, CYREG_GPIO_PRT0_DR_CLR
.set CPS__0__DR_INV, CYREG_GPIO_PRT0_DR_INV
.set CPS__0__DR_SET, CYREG_GPIO_PRT0_DR_SET
.set CPS__0__HSIOM, CYREG_HSIOM_PORT_SEL0
.set CPS__0__HSIOM_MASK, 0x00000F00
.set CPS__0__HSIOM_SHIFT, 8
.set CPS__0__INTCFG, CYREG_GPIO_PRT0_INTR_CFG
.set CPS__0__INTR, CYREG_GPIO_PRT0_INTR
.set CPS__0__INTR_CFG, CYREG_GPIO_PRT0_INTR_CFG
.set CPS__0__INTSTAT, CYREG_GPIO_PRT0_INTR
.set CPS__0__MASK, 0x04
.set CPS__0__PA__CFG0, CYREG_UDB_PA0_CFG0
.set CPS__0__PA__CFG1, CYREG_UDB_PA0_CFG1
.set CPS__0__PA__CFG10, CYREG_UDB_PA0_CFG10
.set CPS__0__PA__CFG11, CYREG_UDB_PA0_CFG11
.set CPS__0__PA__CFG12, CYREG_UDB_PA0_CFG12
.set CPS__0__PA__CFG13, CYREG_UDB_PA0_CFG13
.set CPS__0__PA__CFG14, CYREG_UDB_PA0_CFG14
.set CPS__0__PA__CFG2, CYREG_UDB_PA0_CFG2
.set CPS__0__PA__CFG3, CYREG_UDB_PA0_CFG3
.set CPS__0__PA__CFG4, CYREG_UDB_PA0_CFG4
.set CPS__0__PA__CFG5, CYREG_UDB_PA0_CFG5
.set CPS__0__PA__CFG6, CYREG_UDB_PA0_CFG6
.set CPS__0__PA__CFG7, CYREG_UDB_PA0_CFG7
.set CPS__0__PA__CFG8, CYREG_UDB_PA0_CFG8
.set CPS__0__PA__CFG9, CYREG_UDB_PA0_CFG9
.set CPS__0__PC, CYREG_GPIO_PRT0_PC
.set CPS__0__PC2, CYREG_GPIO_PRT0_PC2
.set CPS__0__PORT, 0
.set CPS__0__PS, CYREG_GPIO_PRT0_PS
.set CPS__0__SHIFT, 2
.set CPS__DR, CYREG_GPIO_PRT0_DR
.set CPS__DR_CLR, CYREG_GPIO_PRT0_DR_CLR
.set CPS__DR_INV, CYREG_GPIO_PRT0_DR_INV
.set CPS__DR_SET, CYREG_GPIO_PRT0_DR_SET
.set CPS__INTCFG, CYREG_GPIO_PRT0_INTR_CFG
.set CPS__INTR, CYREG_GPIO_PRT0_INTR
.set CPS__INTR_CFG, CYREG_GPIO_PRT0_INTR_CFG
.set CPS__INTSTAT, CYREG_GPIO_PRT0_INTR
.set CPS__MASK, 0x04
.set CPS__PA__CFG0, CYREG_UDB_PA0_CFG0
.set CPS__PA__CFG1, CYREG_UDB_PA0_CFG1
.set CPS__PA__CFG10, CYREG_UDB_PA0_CFG10
.set CPS__PA__CFG11, CYREG_UDB_PA0_CFG11
.set CPS__PA__CFG12, CYREG_UDB_PA0_CFG12
.set CPS__PA__CFG13, CYREG_UDB_PA0_CFG13
.set CPS__PA__CFG14, CYREG_UDB_PA0_CFG14
.set CPS__PA__CFG2, CYREG_UDB_PA0_CFG2
.set CPS__PA__CFG3, CYREG_UDB_PA0_CFG3
.set CPS__PA__CFG4, CYREG_UDB_PA0_CFG4
.set CPS__PA__CFG5, CYREG_UDB_PA0_CFG5
.set CPS__PA__CFG6, CYREG_UDB_PA0_CFG6
.set CPS__PA__CFG7, CYREG_UDB_PA0_CFG7
.set CPS__PA__CFG8, CYREG_UDB_PA0_CFG8
.set CPS__PA__CFG9, CYREG_UDB_PA0_CFG9
.set CPS__PC, CYREG_GPIO_PRT0_PC
.set CPS__PC2, CYREG_GPIO_PRT0_PC2
.set CPS__PORT, 0
.set CPS__PS, CYREG_GPIO_PRT0_PS
.set CPS__SHIFT, 2

/* CSD */
.set CSD__0__DR, CYREG_GPIO_PRT0_DR
.set CSD__0__DR_CLR, CYREG_GPIO_PRT0_DR_CLR
.set CSD__0__DR_INV, CYREG_GPIO_PRT0_DR_INV
.set CSD__0__DR_SET, CYREG_GPIO_PRT0_DR_SET
.set CSD__0__HSIOM, CYREG_HSIOM_PORT_SEL0
.set CSD__0__HSIOM_MASK, 0x0000F000
.set CSD__0__HSIOM_SHIFT, 12
.set CSD__0__INTCFG, CYREG_GPIO_PRT0_INTR_CFG
.set CSD__0__INTR, CYREG_GPIO_PRT0_INTR
.set CSD__0__INTR_CFG, CYREG_GPIO_PRT0_INTR_CFG
.set CSD__0__INTSTAT, CYREG_GPIO_PRT0_INTR
.set CSD__0__MASK, 0x08
.set CSD__0__PA__CFG0, CYREG_UDB_PA0_CFG0
.set CSD__0__PA__CFG1, CYREG_UDB_PA0_CFG1
.set CSD__0__PA__CFG10, CYREG_UDB_PA0_CFG10
.set CSD__0__PA__CFG11, CYREG_UDB_PA0_CFG11
.set CSD__0__PA__CFG12, CYREG_UDB_PA0_CFG12
.set CSD__0__PA__CFG13, CYREG_UDB_PA0_CFG13
.set CSD__0__PA__CFG14, CYREG_UDB_PA0_CFG14
.set CSD__0__PA__CFG2, CYREG_UDB_PA0_CFG2
.set CSD__0__PA__CFG3, CYREG_UDB_PA0_CFG3
.set CSD__0__PA__CFG4, CYREG_UDB_PA0_CFG4
.set CSD__0__PA__CFG5, CYREG_UDB_PA0_CFG5
.set CSD__0__PA__CFG6, CYREG_UDB_PA0_CFG6
.set CSD__0__PA__CFG7, CYREG_UDB_PA0_CFG7
.set CSD__0__PA__CFG8, CYREG_UDB_PA0_CFG8
.set CSD__0__PA__CFG9, CYREG_UDB_PA0_CFG9
.set CSD__0__PC, CYREG_GPIO_PRT0_PC
.set CSD__0__PC2, CYREG_GPIO_PRT0_PC2
.set CSD__0__PORT, 0
.set CSD__0__PS, CYREG_GPIO_PRT0_PS
.set CSD__0__SHIFT, 3
.set CSD__DR, CYREG_GPIO_PRT0_DR
.set CSD__DR_CLR, CYREG_GPIO_PRT0_DR_CLR
.set CSD__DR_INV, CYREG_GPIO_PRT0_DR_INV
.set CSD__DR_SET, CYREG_GPIO_PRT0_DR_SET
.set CSD__INTCFG, CYREG_GPIO_PRT0_INTR_CFG
.set CSD__INTR, CYREG_GPIO_PRT0_INTR
.set CSD__INTR_CFG, CYREG_GPIO_PRT0_INTR_CFG
.set CSD__INTSTAT, CYREG_GPIO_PRT0_INTR
.set CSD__MASK, 0x08
.set CSD__PA__CFG0, CYREG_UDB_PA0_CFG0
.set CSD__PA__CFG1, CYREG_UDB_PA0_CFG1
.set CSD__PA__CFG10, CYREG_UDB_PA0_CFG10
.set CSD__PA__CFG11, CYREG_UDB_PA0_CFG11
.set CSD__PA__CFG12, CYREG_UDB_PA0_CFG12
.set CSD__PA__CFG13, CYREG_UDB_PA0_CFG13
.set CSD__PA__CFG14, CYREG_UDB_PA0_CFG14
.set CSD__PA__CFG2, CYREG_UDB_PA0_CFG2
.set CSD__PA__CFG3, CYREG_UDB_PA0_CFG3
.set CSD__PA__CFG4, CYREG_UDB_PA0_CFG4
.set CSD__PA__CFG5, CYREG_UDB_PA0_CFG5
.set CSD__PA__CFG6, CYREG_UDB_PA0_CFG6
.set CSD__PA__CFG7, CYREG_UDB_PA0_CFG7
.set CSD__PA__CFG8, CYREG_UDB_PA0_CFG8
.set CSD__PA__CFG9, CYREG_UDB_PA0_CFG9
.set CSD__PC, CYREG_GPIO_PRT0_PC
.set CSD__PC2, CYREG_GPIO_PRT0_PC2
.set CSD__PORT, 0
.set CSD__PS, CYREG_GPIO_PRT0_PS
.set CSD__SHIFT, 3

/* CyBle */
.set CyBle_bless_isr__INTC_CLR_EN_REG, CYREG_CM0_ICER
.set CyBle_bless_isr__INTC_CLR_PD_REG, CYREG_CM0_ICPR
.set CyBle_bless_isr__INTC_MASK, 0x1000
.set CyBle_bless_isr__INTC_NUMBER, 12
.set CyBle_bless_isr__INTC_PRIOR_MASK, 0xC0
.set CyBle_bless_isr__INTC_PRIOR_NUM, 3
.set CyBle_bless_isr__INTC_PRIOR_REG, CYREG_CM0_IPR3
.set CyBle_bless_isr__INTC_SET_EN_REG, CYREG_CM0_ISER
.set CyBle_bless_isr__INTC_SET_PD_REG, CYREG_CM0_ISPR
.set CyBle_cy_m0s8_ble__ADC_BUMP1, CYREG_BLE_BLERD_ADC_BUMP1
.set CyBle_cy_m0s8_ble__ADC_BUMP2, CYREG_BLE_BLERD_ADC_BUMP2
.set CyBle_cy_m0s8_ble__ADV_CH_TX_POWER, CYREG_BLE_BLELL_ADV_CH_TX_POWER
.set CyBle_cy_m0s8_ble__ADV_CONFIG, CYREG_BLE_BLELL_ADV_CONFIG
.set CyBle_cy_m0s8_ble__ADV_INTERVAL_TIMEOUT, CYREG_BLE_BLELL_ADV_INTERVAL_TIMEOUT
.set CyBle_cy_m0s8_ble__ADV_INTR, CYREG_BLE_BLELL_ADV_INTR
.set CyBle_cy_m0s8_ble__ADV_NEXT_INSTANT, CYREG_BLE_BLELL_ADV_NEXT_INSTANT
.set CyBle_cy_m0s8_ble__ADV_PARAMS, CYREG_BLE_BLELL_ADV_PARAMS
.set CyBle_cy_m0s8_ble__ADV_SCN_RSP_TX_FIFO, CYREG_BLE_BLELL_ADV_SCN_RSP_TX_FIFO
.set CyBle_cy_m0s8_ble__ADV_TX_DATA_FIFO, CYREG_BLE_BLELL_ADV_TX_DATA_FIFO
.set CyBle_cy_m0s8_ble__AGC, CYREG_BLE_BLERD_AGC
.set CyBle_cy_m0s8_ble__BALUN, CYREG_BLE_BLERD_BALUN
.set CyBle_cy_m0s8_ble__BB_BUMP1, CYREG_BLE_BLERD_BB_BUMP1
.set CyBle_cy_m0s8_ble__BB_BUMP2, CYREG_BLE_BLERD_BB_BUMP2
.set CyBle_cy_m0s8_ble__BB_XO, CYREG_BLE_BLERD_BB_XO
.set CyBle_cy_m0s8_ble__BB_XO_CAPTRIM, CYREG_BLE_BLERD_BB_XO_CAPTRIM
.set CyBle_cy_m0s8_ble__CE_CNFG_STS_REGISTER, CYREG_BLE_BLELL_CE_CNFG_STS_REGISTER
.set CyBle_cy_m0s8_ble__CE_LENGTH, CYREG_BLE_BLELL_CE_LENGTH
.set CyBle_cy_m0s8_ble__CFG_1_FCAL, CYREG_BLE_BLERD_CFG_1_FCAL
.set CyBle_cy_m0s8_ble__CFG_2_FCAL, CYREG_BLE_BLERD_CFG_2_FCAL
.set CyBle_cy_m0s8_ble__CFG_3_FCAL, CYREG_BLE_BLERD_CFG_3_FCAL
.set CyBle_cy_m0s8_ble__CFG_4_FCAL, CYREG_BLE_BLERD_CFG_4_FCAL
.set CyBle_cy_m0s8_ble__CFG_5_FCAL, CYREG_BLE_BLERD_CFG_5_FCAL
.set CyBle_cy_m0s8_ble__CFG_6_FCAL, CYREG_BLE_BLERD_CFG_6_FCAL
.set CyBle_cy_m0s8_ble__CFG1, CYREG_BLE_BLERD_CFG1
.set CyBle_cy_m0s8_ble__CFG2, CYREG_BLE_BLERD_CFG2
.set CyBle_cy_m0s8_ble__CFGCTRL, CYREG_BLE_BLERD_CFGCTRL
.set CyBle_cy_m0s8_ble__CLOCK_CONFIG, CYREG_BLE_BLELL_CLOCK_CONFIG
.set CyBle_cy_m0s8_ble__COMMAND_REGISTER, CYREG_BLE_BLELL_COMMAND_REGISTER
.set CyBle_cy_m0s8_ble__CONN_CE_COUNTER, CYREG_BLE_BLELL_CONN_CE_COUNTER
.set CyBle_cy_m0s8_ble__CONN_CE_INSTANT, CYREG_BLE_BLELL_CONN_CE_INSTANT
.set CyBle_cy_m0s8_ble__CONN_CH_TX_POWER, CYREG_BLE_BLELL_CONN_CH_TX_POWER
.set CyBle_cy_m0s8_ble__CONN_CONFIG, CYREG_BLE_BLELL_CONN_CONFIG
.set CyBle_cy_m0s8_ble__CONN_INDEX, CYREG_BLE_BLELL_CONN_INDEX
.set CyBle_cy_m0s8_ble__CONN_INTERVAL, CYREG_BLE_BLELL_CONN_INTERVAL
.set CyBle_cy_m0s8_ble__CONN_INTR, CYREG_BLE_BLELL_CONN_INTR
.set CyBle_cy_m0s8_ble__CONN_INTR_MASK, CYREG_BLE_BLELL_CONN_INTR_MASK
.set CyBle_cy_m0s8_ble__CONN_PARAM1, CYREG_BLE_BLELL_CONN_PARAM1
.set CyBle_cy_m0s8_ble__CONN_PARAM2, CYREG_BLE_BLELL_CONN_PARAM2
.set CyBle_cy_m0s8_ble__CONN_REQ_WORD0, CYREG_BLE_BLELL_CONN_REQ_WORD0
.set CyBle_cy_m0s8_ble__CONN_REQ_WORD1, CYREG_BLE_BLELL_CONN_REQ_WORD1
.set CyBle_cy_m0s8_ble__CONN_REQ_WORD10, CYREG_BLE_BLELL_CONN_REQ_WORD10
.set CyBle_cy_m0s8_ble__CONN_REQ_WORD11, CYREG_BLE_BLELL_CONN_REQ_WORD11
.set CyBle_cy_m0s8_ble__CONN_REQ_WORD2, CYREG_BLE_BLELL_CONN_REQ_WORD2
.set CyBle_cy_m0s8_ble__CONN_REQ_WORD3, CYREG_BLE_BLELL_CONN_REQ_WORD3
.set CyBle_cy_m0s8_ble__CONN_REQ_WORD4, CYREG_BLE_BLELL_CONN_REQ_WORD4
.set CyBle_cy_m0s8_ble__CONN_REQ_WORD5, CYREG_BLE_BLELL_CONN_REQ_WORD5
.set CyBle_cy_m0s8_ble__CONN_REQ_WORD6, CYREG_BLE_BLELL_CONN_REQ_WORD6
.set CyBle_cy_m0s8_ble__CONN_REQ_WORD7, CYREG_BLE_BLELL_CONN_REQ_WORD7
.set CyBle_cy_m0s8_ble__CONN_REQ_WORD8, CYREG_BLE_BLELL_CONN_REQ_WORD8
.set CyBle_cy_m0s8_ble__CONN_REQ_WORD9, CYREG_BLE_BLELL_CONN_REQ_WORD9
.set CyBle_cy_m0s8_ble__CONN_RXMEM_BASE_ADDR, CYREG_BLE_BLELL_CONN_RXMEM_BASE_ADDR
.set CyBle_cy_m0s8_ble__CONN_STATUS, CYREG_BLE_BLELL_CONN_STATUS
.set CyBle_cy_m0s8_ble__CONN_TXMEM_BASE_ADDR, CYREG_BLE_BLELL_CONN_TXMEM_BASE_ADDR
.set CyBle_cy_m0s8_ble__CONN_UPDATE_NEW_INTERVAL, CYREG_BLE_BLELL_CONN_UPDATE_NEW_INTERVAL
.set CyBle_cy_m0s8_ble__CONN_UPDATE_NEW_LATENCY, CYREG_BLE_BLELL_CONN_UPDATE_NEW_LATENCY
.set CyBle_cy_m0s8_ble__CONN_UPDATE_NEW_SL_INTERVAL, CYREG_BLE_BLELL_CONN_UPDATE_NEW_SL_INTERVAL
.set CyBle_cy_m0s8_ble__CONN_UPDATE_NEW_SUP_TO, CYREG_BLE_BLELL_CONN_UPDATE_NEW_SUP_TO
.set CyBle_cy_m0s8_ble__CTR1, CYREG_BLE_BLERD_CTR1
.set CyBle_cy_m0s8_ble__DATA_CHANNELS_H0, CYREG_BLE_BLELL_DATA_CHANNELS_H0
.set CyBle_cy_m0s8_ble__DATA_CHANNELS_H1, CYREG_BLE_BLELL_DATA_CHANNELS_H1
.set CyBle_cy_m0s8_ble__DATA_CHANNELS_L0, CYREG_BLE_BLELL_DATA_CHANNELS_L0
.set CyBle_cy_m0s8_ble__DATA_CHANNELS_L1, CYREG_BLE_BLELL_DATA_CHANNELS_L1
.set CyBle_cy_m0s8_ble__DATA_CHANNELS_M0, CYREG_BLE_BLELL_DATA_CHANNELS_M0
.set CyBle_cy_m0s8_ble__DATA_CHANNELS_M1, CYREG_BLE_BLELL_DATA_CHANNELS_M1
.set CyBle_cy_m0s8_ble__DATA_LIST_ACK_UPDATE__STATUS, CYREG_BLE_BLELL_DATA_LIST_ACK_UPDATE__STATUS
.set CyBle_cy_m0s8_ble__DATA_LIST_SENT_UPDATE__STATUS, CYREG_BLE_BLELL_DATA_LIST_SENT_UPDATE__STATUS
.set CyBle_cy_m0s8_ble__DATA_MEM_DESCRIPTOR0, CYREG_BLE_BLELL_DATA_MEM_DESCRIPTOR0
.set CyBle_cy_m0s8_ble__DATA_MEM_DESCRIPTOR1, CYREG_BLE_BLELL_DATA_MEM_DESCRIPTOR1
.set CyBle_cy_m0s8_ble__DATA_MEM_DESCRIPTOR2, CYREG_BLE_BLELL_DATA_MEM_DESCRIPTOR2
.set CyBle_cy_m0s8_ble__DATA_MEM_DESCRIPTOR3, CYREG_BLE_BLELL_DATA_MEM_DESCRIPTOR3
.set CyBle_cy_m0s8_ble__DATA_MEM_DESCRIPTOR4, CYREG_BLE_BLELL_DATA_MEM_DESCRIPTOR4
.set CyBle_cy_m0s8_ble__DATA0, CYREG_BLE_BLELL_DATA0
.set CyBle_cy_m0s8_ble__DATA1, CYREG_BLE_BLELL_DATA1
.set CyBle_cy_m0s8_ble__DATA10, CYREG_BLE_BLELL_DATA10
.set CyBle_cy_m0s8_ble__DATA11, CYREG_BLE_BLELL_DATA11
.set CyBle_cy_m0s8_ble__DATA12, CYREG_BLE_BLELL_DATA12
.set CyBle_cy_m0s8_ble__DATA13, CYREG_BLE_BLELL_DATA13
.set CyBle_cy_m0s8_ble__DATA2, CYREG_BLE_BLELL_DATA2
.set CyBle_cy_m0s8_ble__DATA3, CYREG_BLE_BLELL_DATA3
.set CyBle_cy_m0s8_ble__DATA4, CYREG_BLE_BLELL_DATA4
.set CyBle_cy_m0s8_ble__DATA5, CYREG_BLE_BLELL_DATA5
.set CyBle_cy_m0s8_ble__DATA6, CYREG_BLE_BLELL_DATA6
.set CyBle_cy_m0s8_ble__DATA7, CYREG_BLE_BLELL_DATA7
.set CyBle_cy_m0s8_ble__DATA8, CYREG_BLE_BLELL_DATA8
.set CyBle_cy_m0s8_ble__DATA9, CYREG_BLE_BLELL_DATA9
.set CyBle_cy_m0s8_ble__DBG_1, CYREG_BLE_BLERD_DBG_1
.set CyBle_cy_m0s8_ble__DBG_2, CYREG_BLE_BLERD_DBG_2
.set CyBle_cy_m0s8_ble__DBG_3, CYREG_BLE_BLERD_DBG_3
.set CyBle_cy_m0s8_ble__DBG_BB, CYREG_BLE_BLERD_DBG_BB
.set CyBle_cy_m0s8_ble__DBUS, CYREG_BLE_BLERD_DBUS
.set CyBle_cy_m0s8_ble__DC, CYREG_BLE_BLERD_DC
.set CyBle_cy_m0s8_ble__DCCAL, CYREG_BLE_BLERD_DCCAL
.set CyBle_cy_m0s8_ble__DEV_PUB_ADDR_H, CYREG_BLE_BLELL_DEV_PUB_ADDR_H
.set CyBle_cy_m0s8_ble__DEV_PUB_ADDR_L, CYREG_BLE_BLELL_DEV_PUB_ADDR_L
.set CyBle_cy_m0s8_ble__DEV_PUB_ADDR_M, CYREG_BLE_BLELL_DEV_PUB_ADDR_M
.set CyBle_cy_m0s8_ble__DEVICE_RAND_ADDR_H, CYREG_BLE_BLELL_DEVICE_RAND_ADDR_H
.set CyBle_cy_m0s8_ble__DEVICE_RAND_ADDR_L, CYREG_BLE_BLELL_DEVICE_RAND_ADDR_L
.set CyBle_cy_m0s8_ble__DEVICE_RAND_ADDR_M, CYREG_BLE_BLELL_DEVICE_RAND_ADDR_M
.set CyBle_cy_m0s8_ble__DIAG1, CYREG_BLE_BLERD_DIAG1
.set CyBle_cy_m0s8_ble__DPLL_CONFIG, CYREG_BLE_BLELL_DPLL_CONFIG
.set CyBle_cy_m0s8_ble__DSM1, CYREG_BLE_BLERD_DSM1
.set CyBle_cy_m0s8_ble__DSM2, CYREG_BLE_BLERD_DSM2
.set CyBle_cy_m0s8_ble__DSM3, CYREG_BLE_BLERD_DSM3
.set CyBle_cy_m0s8_ble__DSM4, CYREG_BLE_BLERD_DSM4
.set CyBle_cy_m0s8_ble__DSM5, CYREG_BLE_BLERD_DSM5
.set CyBle_cy_m0s8_ble__DSM6, CYREG_BLE_BLERD_DSM6
.set CyBle_cy_m0s8_ble__DTM_RX_PKT_COUNT, CYREG_BLE_BLELL_DTM_RX_PKT_COUNT
.set CyBle_cy_m0s8_ble__ENC_CONFIG, CYREG_BLE_BLELL_ENC_CONFIG
.set CyBle_cy_m0s8_ble__ENC_INTR, CYREG_BLE_BLELL_ENC_INTR
.set CyBle_cy_m0s8_ble__ENC_INTR_EN, CYREG_BLE_BLELL_ENC_INTR_EN
.set CyBle_cy_m0s8_ble__ENC_KEY0, CYREG_BLE_BLELL_ENC_KEY0
.set CyBle_cy_m0s8_ble__ENC_KEY1, CYREG_BLE_BLELL_ENC_KEY1
.set CyBle_cy_m0s8_ble__ENC_KEY2, CYREG_BLE_BLELL_ENC_KEY2
.set CyBle_cy_m0s8_ble__ENC_KEY3, CYREG_BLE_BLELL_ENC_KEY3
.set CyBle_cy_m0s8_ble__ENC_KEY4, CYREG_BLE_BLELL_ENC_KEY4
.set CyBle_cy_m0s8_ble__ENC_KEY5, CYREG_BLE_BLELL_ENC_KEY5
.set CyBle_cy_m0s8_ble__ENC_KEY6, CYREG_BLE_BLELL_ENC_KEY6
.set CyBle_cy_m0s8_ble__ENC_KEY7, CYREG_BLE_BLELL_ENC_KEY7
.set CyBle_cy_m0s8_ble__ENC_PARAMS, CYREG_BLE_BLELL_ENC_PARAMS
.set CyBle_cy_m0s8_ble__EVENT_ENABLE, CYREG_BLE_BLELL_EVENT_ENABLE
.set CyBle_cy_m0s8_ble__EVENT_INTR, CYREG_BLE_BLELL_EVENT_INTR
.set CyBle_cy_m0s8_ble__FCAL_TEST, CYREG_BLE_BLERD_FCAL_TEST
.set CyBle_cy_m0s8_ble__FPD_TEST, CYREG_BLE_BLERD_FPD_TEST
.set CyBle_cy_m0s8_ble__FSM, CYREG_BLE_BLERD_FSM
.set CyBle_cy_m0s8_ble__IM, CYREG_BLE_BLERD_IM
.set CyBle_cy_m0s8_ble__INIT_CONFIG, CYREG_BLE_BLELL_INIT_CONFIG
.set CyBle_cy_m0s8_ble__INIT_INTERVAL, CYREG_BLE_BLELL_INIT_INTERVAL
.set CyBle_cy_m0s8_ble__INIT_INTR, CYREG_BLE_BLELL_INIT_INTR
.set CyBle_cy_m0s8_ble__INIT_NEXT_INSTANT, CYREG_BLE_BLELL_INIT_NEXT_INSTANT
.set CyBle_cy_m0s8_ble__INIT_PARAM, CYREG_BLE_BLELL_INIT_PARAM
.set CyBle_cy_m0s8_ble__INIT_SCN_ADV_RX_FIFO, CYREG_BLE_BLELL_INIT_SCN_ADV_RX_FIFO
.set CyBle_cy_m0s8_ble__INIT_WINDOW, CYREG_BLE_BLELL_INIT_WINDOW
.set CyBle_cy_m0s8_ble__IQMIS, CYREG_BLE_BLERD_IQMIS
.set CyBle_cy_m0s8_ble__IV_MASTER0, CYREG_BLE_BLELL_IV_MASTER0
.set CyBle_cy_m0s8_ble__IV_MASTER1, CYREG_BLE_BLELL_IV_MASTER1
.set CyBle_cy_m0s8_ble__IV_SLAVE0, CYREG_BLE_BLELL_IV_SLAVE0
.set CyBle_cy_m0s8_ble__IV_SLAVE1, CYREG_BLE_BLELL_IV_SLAVE1
.set CyBle_cy_m0s8_ble__KVCAL, CYREG_BLE_BLERD_KVCAL
.set CyBle_cy_m0s8_ble__LDO, CYREG_BLE_BLERD_LDO
.set CyBle_cy_m0s8_ble__LDO_BYPASS, CYREG_BLE_BLERD_LDO_BYPASS
.set CyBle_cy_m0s8_ble__LE_PING_TIMER_ADDR, CYREG_BLE_BLELL_LE_PING_TIMER_ADDR
.set CyBle_cy_m0s8_ble__LE_PING_TIMER_NEXT_EXP, CYREG_BLE_BLELL_LE_PING_TIMER_NEXT_EXP
.set CyBle_cy_m0s8_ble__LE_PING_TIMER_OFFSET, CYREG_BLE_BLELL_LE_PING_TIMER_OFFSET
.set CyBle_cy_m0s8_ble__LE_PING_TIMER_WRAP_COUNT, CYREG_BLE_BLELL_LE_PING_TIMER_WRAP_COUNT
.set CyBle_cy_m0s8_ble__LE_RF_TEST_MODE, CYREG_BLE_BLELL_LE_RF_TEST_MODE
.set CyBle_cy_m0s8_ble__LF_CLK_CTRL, CYREG_BLE_BLESS_LF_CLK_CTRL
.set CyBle_cy_m0s8_ble__LL_CLK_EN, CYREG_BLE_BLESS_LL_CLK_EN
.set CyBle_cy_m0s8_ble__LL_DSM_CTRL, CYREG_BLE_BLESS_LL_DSM_CTRL
.set CyBle_cy_m0s8_ble__LL_DSM_INTR_STAT, CYREG_BLE_BLESS_LL_DSM_INTR_STAT
.set CyBle_cy_m0s8_ble__LLH_FEATURE_CONFIG, CYREG_BLE_BLELL_LLH_FEATURE_CONFIG
.set CyBle_cy_m0s8_ble__MIC_IN0, CYREG_BLE_BLELL_MIC_IN0
.set CyBle_cy_m0s8_ble__MIC_IN1, CYREG_BLE_BLELL_MIC_IN1
.set CyBle_cy_m0s8_ble__MIC_OUT0, CYREG_BLE_BLELL_MIC_OUT0
.set CyBle_cy_m0s8_ble__MIC_OUT1, CYREG_BLE_BLELL_MIC_OUT1
.set CyBle_cy_m0s8_ble__MODEM, CYREG_BLE_BLERD_MODEM
.set CyBle_cy_m0s8_ble__MONI, CYREG_BLE_BLERD_MONI
.set CyBle_cy_m0s8_ble__NEXT_CE_INSTANT, CYREG_BLE_BLELL_NEXT_CE_INSTANT
.set CyBle_cy_m0s8_ble__NEXT_RESP_TIMER_EXP, CYREG_BLE_BLELL_NEXT_RESP_TIMER_EXP
.set CyBle_cy_m0s8_ble__NEXT_SUP_TO, CYREG_BLE_BLELL_NEXT_SUP_TO
.set CyBle_cy_m0s8_ble__OFFSET_TO_FIRST_INSTANT, CYREG_BLE_BLELL_OFFSET_TO_FIRST_INSTANT
.set CyBle_cy_m0s8_ble__PACKET_COUNTER0, CYREG_BLE_BLELL_PACKET_COUNTER0
.set CyBle_cy_m0s8_ble__PACKET_COUNTER1, CYREG_BLE_BLELL_PACKET_COUNTER1
.set CyBle_cy_m0s8_ble__PACKET_COUNTER2, CYREG_BLE_BLELL_PACKET_COUNTER2
.set CyBle_cy_m0s8_ble__PDU_ACCESS_ADDR_H_REGISTER, CYREG_BLE_BLELL_PDU_ACCESS_ADDR_H_REGISTER
.set CyBle_cy_m0s8_ble__PDU_ACCESS_ADDR_L_REGISTER, CYREG_BLE_BLELL_PDU_ACCESS_ADDR_L_REGISTER
.set CyBle_cy_m0s8_ble__PDU_RESP_TIMER, CYREG_BLE_BLELL_PDU_RESP_TIMER
.set CyBle_cy_m0s8_ble__PEER_ADDR_H, CYREG_BLE_BLELL_PEER_ADDR_H
.set CyBle_cy_m0s8_ble__PEER_ADDR_L, CYREG_BLE_BLELL_PEER_ADDR_L
.set CyBle_cy_m0s8_ble__PEER_ADDR_M, CYREG_BLE_BLELL_PEER_ADDR_M
.set CyBle_cy_m0s8_ble__POC_REG__TIM_CONTROL, CYREG_BLE_BLELL_POC_REG__TIM_CONTROL
.set CyBle_cy_m0s8_ble__RCCAL, CYREG_BLE_BLERD_RCCAL
.set CyBle_cy_m0s8_ble__READ_IQ_1, CYREG_BLE_BLERD_READ_IQ_1
.set CyBle_cy_m0s8_ble__READ_IQ_2, CYREG_BLE_BLERD_READ_IQ_2
.set CyBle_cy_m0s8_ble__READ_IQ_3, CYREG_BLE_BLERD_READ_IQ_3
.set CyBle_cy_m0s8_ble__READ_IQ_4, CYREG_BLE_BLERD_READ_IQ_4
.set CyBle_cy_m0s8_ble__RECEIVE_TRIG_CTRL, CYREG_BLE_BLELL_RECEIVE_TRIG_CTRL
.set CyBle_cy_m0s8_ble__RF_CONFIG, CYREG_BLE_BLESS_RF_CONFIG
.set CyBle_cy_m0s8_ble__RMAP, CYREG_BLE_BLERD_RMAP
.set CyBle_cy_m0s8_ble__RSSI, CYREG_BLE_BLERD_RSSI
.set CyBle_cy_m0s8_ble__RX, CYREG_BLE_BLERD_RX
.set CyBle_cy_m0s8_ble__RX_BUMP1, CYREG_BLE_BLERD_RX_BUMP1
.set CyBle_cy_m0s8_ble__RX_BUMP2, CYREG_BLE_BLERD_RX_BUMP2
.set CyBle_cy_m0s8_ble__SCAN_CONFIG, CYREG_BLE_BLELL_SCAN_CONFIG
.set CyBle_cy_m0s8_ble__SCAN_INTERVAL, CYREG_BLE_BLELL_SCAN_INTERVAL
.set CyBle_cy_m0s8_ble__SCAN_INTR, CYREG_BLE_BLELL_SCAN_INTR
.set CyBle_cy_m0s8_ble__SCAN_NEXT_INSTANT, CYREG_BLE_BLELL_SCAN_NEXT_INSTANT
.set CyBle_cy_m0s8_ble__SCAN_PARAM, CYREG_BLE_BLELL_SCAN_PARAM
.set CyBle_cy_m0s8_ble__SCAN_WINDOW, CYREG_BLE_BLELL_SCAN_WINDOW
.set CyBle_cy_m0s8_ble__SL_CONN_INTERVAL, CYREG_BLE_BLELL_SL_CONN_INTERVAL
.set CyBle_cy_m0s8_ble__SLAVE_LATENCY, CYREG_BLE_BLELL_SLAVE_LATENCY
.set CyBle_cy_m0s8_ble__SLAVE_TIMING_CONTROL, CYREG_BLE_BLELL_SLAVE_TIMING_CONTROL
.set CyBle_cy_m0s8_ble__SLV_WIN_ADJ, CYREG_BLE_BLELL_SLV_WIN_ADJ
.set CyBle_cy_m0s8_ble__SUP_TIMEOUT, CYREG_BLE_BLELL_SUP_TIMEOUT
.set CyBle_cy_m0s8_ble__SY, CYREG_BLE_BLERD_SY
.set CyBle_cy_m0s8_ble__SY_BUMP1, CYREG_BLE_BLERD_SY_BUMP1
.set CyBle_cy_m0s8_ble__SY_BUMP2, CYREG_BLE_BLERD_SY_BUMP2
.set CyBle_cy_m0s8_ble__TEST, CYREG_BLE_BLERD_TEST
.set CyBle_cy_m0s8_ble__TEST2_SY, CYREG_BLE_BLERD_TEST2_SY
.set CyBle_cy_m0s8_ble__THRSHD1, CYREG_BLE_BLERD_THRSHD1
.set CyBle_cy_m0s8_ble__THRSHD2, CYREG_BLE_BLERD_THRSHD2
.set CyBle_cy_m0s8_ble__THRSHD3, CYREG_BLE_BLERD_THRSHD3
.set CyBle_cy_m0s8_ble__THRSHD4, CYREG_BLE_BLERD_THRSHD4
.set CyBle_cy_m0s8_ble__THRSHD5, CYREG_BLE_BLERD_THRSHD5
.set CyBle_cy_m0s8_ble__TIM_COUNTER_L, CYREG_BLE_BLELL_TIM_COUNTER_L
.set CyBle_cy_m0s8_ble__TRANSMIT_WINDOW_OFFSET, CYREG_BLE_BLELL_TRANSMIT_WINDOW_OFFSET
.set CyBle_cy_m0s8_ble__TRANSMIT_WINDOW_SIZE, CYREG_BLE_BLELL_TRANSMIT_WINDOW_SIZE
.set CyBle_cy_m0s8_ble__TX, CYREG_BLE_BLERD_TX
.set CyBle_cy_m0s8_ble__TX_BUMP1, CYREG_BLE_BLERD_TX_BUMP1
.set CyBle_cy_m0s8_ble__TX_BUMP2, CYREG_BLE_BLERD_TX_BUMP2
.set CyBle_cy_m0s8_ble__TX_EN_EXT_DELAY, CYREG_BLE_BLELL_TX_EN_EXT_DELAY
.set CyBle_cy_m0s8_ble__TX_RX_ON_DELAY, CYREG_BLE_BLELL_TX_RX_ON_DELAY
.set CyBle_cy_m0s8_ble__TX_RX_SYNTH_DELAY, CYREG_BLE_BLELL_TX_RX_SYNTH_DELAY
.set CyBle_cy_m0s8_ble__TXRX_HOP, CYREG_BLE_BLELL_TXRX_HOP
.set CyBle_cy_m0s8_ble__WAKEUP_CONFIG, CYREG_BLE_BLELL_WAKEUP_CONFIG
.set CyBle_cy_m0s8_ble__WAKEUP_CONTROL, CYREG_BLE_BLELL_WAKEUP_CONTROL
.set CyBle_cy_m0s8_ble__WCO_CONFIG, CYREG_BLE_BLESS_WCO_CONFIG
.set CyBle_cy_m0s8_ble__WCO_STATUS, CYREG_BLE_BLESS_WCO_STATUS
.set CyBle_cy_m0s8_ble__WCO_TRIM, CYREG_BLE_BLESS_WCO_TRIM
.set CyBle_cy_m0s8_ble__WHITELIST_BASE_ADDR, CYREG_BLE_BLELL_WHITELIST_BASE_ADDR
.set CyBle_cy_m0s8_ble__WIN_MIN_STEP_SIZE, CYREG_BLE_BLELL_WIN_MIN_STEP_SIZE
.set CyBle_cy_m0s8_ble__WINDOW_WIDEN_INTVL, CYREG_BLE_BLELL_WINDOW_WIDEN_INTVL
.set CyBle_cy_m0s8_ble__WINDOW_WIDEN_WINOFF, CYREG_BLE_BLELL_WINDOW_WIDEN_WINOFF
.set CyBle_cy_m0s8_ble__WL_ADDR_TYPE, CYREG_BLE_BLELL_WL_ADDR_TYPE
.set CyBle_cy_m0s8_ble__WL_ENABLE, CYREG_BLE_BLELL_WL_ENABLE
.set CyBle_cy_m0s8_ble__XTAL_CLK_DIV_CONFIG, CYREG_BLE_BLESS_XTAL_CLK_DIV_CONFIG

/* SW2_S */
.set SW2_S__0__DR, CYREG_GPIO_PRT0_DR
.set SW2_S__0__DR_CLR, CYREG_GPIO_PRT0_DR_CLR
.set SW2_S__0__DR_INV, CYREG_GPIO_PRT0_DR_INV
.set SW2_S__0__DR_SET, CYREG_GPIO_PRT0_DR_SET
.set SW2_S__0__HSIOM, CYREG_HSIOM_PORT_SEL0
.set SW2_S__0__HSIOM_MASK, 0x000000F0
.set SW2_S__0__HSIOM_SHIFT, 4
.set SW2_S__0__INTCFG, CYREG_GPIO_PRT0_INTR_CFG
.set SW2_S__0__INTR, CYREG_GPIO_PRT0_INTR
.set SW2_S__0__INTR_CFG, CYREG_GPIO_PRT0_INTR_CFG
.set SW2_S__0__INTSTAT, CYREG_GPIO_PRT0_INTR
.set SW2_S__0__MASK, 0x02
.set SW2_S__0__PA__CFG0, CYREG_UDB_PA0_CFG0
.set SW2_S__0__PA__CFG1, CYREG_UDB_PA0_CFG1
.set SW2_S__0__PA__CFG10, CYREG_UDB_PA0_CFG10
.set SW2_S__0__PA__CFG11, CYREG_UDB_PA0_CFG11
.set SW2_S__0__PA__CFG12, CYREG_UDB_PA0_CFG12
.set SW2_S__0__PA__CFG13, CYREG_UDB_PA0_CFG13
.set SW2_S__0__PA__CFG14, CYREG_UDB_PA0_CFG14
.set SW2_S__0__PA__CFG2, CYREG_UDB_PA0_CFG2
.set SW2_S__0__PA__CFG3, CYREG_UDB_PA0_CFG3
.set SW2_S__0__PA__CFG4, CYREG_UDB_PA0_CFG4
.set SW2_S__0__PA__CFG5, CYREG_UDB_PA0_CFG5
.set SW2_S__0__PA__CFG6, CYREG_UDB_PA0_CFG6
.set SW2_S__0__PA__CFG7, CYREG_UDB_PA0_CFG7
.set SW2_S__0__PA__CFG8, CYREG_UDB_PA0_CFG8
.set SW2_S__0__PA__CFG9, CYREG_UDB_PA0_CFG9
.set SW2_S__0__PC, CYREG_GPIO_PRT0_PC
.set SW2_S__0__PC2, CYREG_GPIO_PRT0_PC2
.set SW2_S__0__PORT, 0
.set SW2_S__0__PS, CYREG_GPIO_PRT0_PS
.set SW2_S__0__SHIFT, 1
.set SW2_S__DR, CYREG_GPIO_PRT0_DR
.set SW2_S__DR_CLR, CYREG_GPIO_PRT0_DR_CLR
.set SW2_S__DR_INV, CYREG_GPIO_PRT0_DR_INV
.set SW2_S__DR_SET, CYREG_GPIO_PRT0_DR_SET
.set SW2_S__INTCFG, CYREG_GPIO_PRT0_INTR_CFG
.set SW2_S__INTR, CYREG_GPIO_PRT0_INTR
.set SW2_S__INTR_CFG, CYREG_GPIO_PRT0_INTR_CFG
.set SW2_S__INTSTAT, CYREG_GPIO_PRT0_INTR
.set SW2_S__MASK, 0x02
.set SW2_S__PA__CFG0, CYREG_UDB_PA0_CFG0
.set SW2_S__PA__CFG1, CYREG_UDB_PA0_CFG1
.set SW2_S__PA__CFG10, CYREG_UDB_PA0_CFG10
.set SW2_S__PA__CFG11, CYREG_UDB_PA0_CFG11
.set SW2_S__PA__CFG12, CYREG_UDB_PA0_CFG12
.set SW2_S__PA__CFG13, CYREG_UDB_PA0_CFG13
.set SW2_S__PA__CFG14, CYREG_UDB_PA0_CFG14
.set SW2_S__PA__CFG2, CYREG_UDB_PA0_CFG2
.set SW2_S__PA__CFG3, CYREG_UDB_PA0_CFG3
.set SW2_S__PA__CFG4, CYREG_UDB_PA0_CFG4
.set SW2_S__PA__CFG5, CYREG_UDB_PA0_CFG5
.set SW2_S__PA__CFG6, CYREG_UDB_PA0_CFG6
.set SW2_S__PA__CFG7, CYREG_UDB_PA0_CFG7
.set SW2_S__PA__CFG8, CYREG_UDB_PA0_CFG8
.set SW2_S__PA__CFG9, CYREG_UDB_PA0_CFG9
.set SW2_S__PC, CYREG_GPIO_PRT0_PC
.set SW2_S__PC2, CYREG_GPIO_PRT0_PC2
.set SW2_S__PORT, 0
.set SW2_S__PS, CYREG_GPIO_PRT0_PS
.set SW2_S__SHIFT, 1
.set SW2_S__SNAP, CYREG_GPIO_PRT0_INTR

/* S_LED */
.set S_LED__0__DR, CYREG_GPIO_PRT2_DR
.set S_LED__0__DR_CLR, CYREG_GPIO_PRT2_DR_CLR
.set S_LED__0__DR_INV, CYREG_GPIO_PRT2_DR_INV
.set S_LED__0__DR_SET, CYREG_GPIO_PRT2_DR_SET
.set S_LED__0__HSIOM, CYREG_HSIOM_PORT_SEL2
.set S_LED__0__HSIOM_MASK, 0x00000F00
.set S_LED__0__HSIOM_SHIFT, 8
.set S_LED__0__INTCFG, CYREG_GPIO_PRT2_INTR_CFG
.set S_LED__0__INTR, CYREG_GPIO_PRT2_INTR
.set S_LED__0__INTR_CFG, CYREG_GPIO_PRT2_INTR_CFG
.set S_LED__0__INTSTAT, CYREG_GPIO_PRT2_INTR
.set S_LED__0__MASK, 0x04
.set S_LED__0__PA__CFG0, CYREG_UDB_PA2_CFG0
.set S_LED__0__PA__CFG1, CYREG_UDB_PA2_CFG1
.set S_LED__0__PA__CFG10, CYREG_UDB_PA2_CFG10
.set S_LED__0__PA__CFG11, CYREG_UDB_PA2_CFG11
.set S_LED__0__PA__CFG12, CYREG_UDB_PA2_CFG12
.set S_LED__0__PA__CFG13, CYREG_UDB_PA2_CFG13
.set S_LED__0__PA__CFG14, CYREG_UDB_PA2_CFG14
.set S_LED__0__PA__CFG2, CYREG_UDB_PA2_CFG2
.set S_LED__0__PA__CFG3, CYREG_UDB_PA2_CFG3
.set S_LED__0__PA__CFG4, CYREG_UDB_PA2_CFG4
.set S_LED__0__PA__CFG5, CYREG_UDB_PA2_CFG5
.set S_LED__0__PA__CFG6, CYREG_UDB_PA2_CFG6
.set S_LED__0__PA__CFG7, CYREG_UDB_PA2_CFG7
.set S_LED__0__PA__CFG8, CYREG_UDB_PA2_CFG8
.set S_LED__0__PA__CFG9, CYREG_UDB_PA2_CFG9
.set S_LED__0__PC, CYREG_GPIO_PRT2_PC
.set S_LED__0__PC2, CYREG_GPIO_PRT2_PC2
.set S_LED__0__PORT, 2
.set S_LED__0__PS, CYREG_GPIO_PRT2_PS
.set S_LED__0__SHIFT, 2
.set S_LED__DR, CYREG_GPIO_PRT2_DR
.set S_LED__DR_CLR, CYREG_GPIO_PRT2_DR_CLR
.set S_LED__DR_INV, CYREG_GPIO_PRT2_DR_INV
.set S_LED__DR_SET, CYREG_GPIO_PRT2_DR_SET
.set S_LED__INTCFG, CYREG_GPIO_PRT2_INTR_CFG
.set S_LED__INTR, CYREG_GPIO_PRT2_INTR
.set S_LED__INTR_CFG, CYREG_GPIO_PRT2_INTR_CFG
.set S_LED__INTSTAT, CYREG_GPIO_PRT2_INTR
.set S_LED__MASK, 0x04
.set S_LED__PA__CFG0, CYREG_UDB_PA2_CFG0
.set S_LED__PA__CFG1, CYREG_UDB_PA2_CFG1
.set S_LED__PA__CFG10, CYREG_UDB_PA2_CFG10
.set S_LED__PA__CFG11, CYREG_UDB_PA2_CFG11
.set S_LED__PA__CFG12, CYREG_UDB_PA2_CFG12
.set S_LED__PA__CFG13, CYREG_UDB_PA2_CFG13
.set S_LED__PA__CFG14, CYREG_UDB_PA2_CFG14
.set S_LED__PA__CFG2, CYREG_UDB_PA2_CFG2
.set S_LED__PA__CFG3, CYREG_UDB_PA2_CFG3
.set S_LED__PA__CFG4, CYREG_UDB_PA2_CFG4
.set S_LED__PA__CFG5, CYREG_UDB_PA2_CFG5
.set S_LED__PA__CFG6, CYREG_UDB_PA2_CFG6
.set S_LED__PA__CFG7, CYREG_UDB_PA2_CFG7
.set S_LED__PA__CFG8, CYREG_UDB_PA2_CFG8
.set S_LED__PA__CFG9, CYREG_UDB_PA2_CFG9
.set S_LED__PC, CYREG_GPIO_PRT2_PC
.set S_LED__PC2, CYREG_GPIO_PRT2_PC2
.set S_LED__PORT, 2
.set S_LED__PS, CYREG_GPIO_PRT2_PS
.set S_LED__SHIFT, 2

/* UART_tx */
.set UART_tx__0__DR, CYREG_GPIO_PRT3_DR
.set UART_tx__0__DR_CLR, CYREG_GPIO_PRT3_DR_CLR
.set UART_tx__0__DR_INV, CYREG_GPIO_PRT3_DR_INV
.set UART_tx__0__DR_SET, CYREG_GPIO_PRT3_DR_SET
.set UART_tx__0__HSIOM, CYREG_HSIOM_PORT_SEL3
.set UART_tx__0__HSIOM_MASK, 0x000000F0
.set UART_tx__0__HSIOM_SHIFT, 4
.set UART_tx__0__INTCFG, CYREG_GPIO_PRT3_INTR_CFG
.set UART_tx__0__INTR, CYREG_GPIO_PRT3_INTR
.set UART_tx__0__INTR_CFG, CYREG_GPIO_PRT3_INTR_CFG
.set UART_tx__0__INTSTAT, CYREG_GPIO_PRT3_INTR
.set UART_tx__0__MASK, 0x02
.set UART_tx__0__PA__CFG0, CYREG_UDB_PA3_CFG0
.set UART_tx__0__PA__CFG1, CYREG_UDB_PA3_CFG1
.set UART_tx__0__PA__CFG10, CYREG_UDB_PA3_CFG10
.set UART_tx__0__PA__CFG11, CYREG_UDB_PA3_CFG11
.set UART_tx__0__PA__CFG12, CYREG_UDB_PA3_CFG12
.set UART_tx__0__PA__CFG13, CYREG_UDB_PA3_CFG13
.set UART_tx__0__PA__CFG14, CYREG_UDB_PA3_CFG14
.set UART_tx__0__PA__CFG2, CYREG_UDB_PA3_CFG2
.set UART_tx__0__PA__CFG3, CYREG_UDB_PA3_CFG3
.set UART_tx__0__PA__CFG4, CYREG_UDB_PA3_CFG4
.set UART_tx__0__PA__CFG5, CYREG_UDB_PA3_CFG5
.set UART_tx__0__PA__CFG6, CYREG_UDB_PA3_CFG6
.set UART_tx__0__PA__CFG7, CYREG_UDB_PA3_CFG7
.set UART_tx__0__PA__CFG8, CYREG_UDB_PA3_CFG8
.set UART_tx__0__PA__CFG9, CYREG_UDB_PA3_CFG9
.set UART_tx__0__PC, CYREG_GPIO_PRT3_PC
.set UART_tx__0__PC2, CYREG_GPIO_PRT3_PC2
.set UART_tx__0__PORT, 3
.set UART_tx__0__PS, CYREG_GPIO_PRT3_PS
.set UART_tx__0__SHIFT, 1
.set UART_tx__DR, CYREG_GPIO_PRT3_DR
.set UART_tx__DR_CLR, CYREG_GPIO_PRT3_DR_CLR
.set UART_tx__DR_INV, CYREG_GPIO_PRT3_DR_INV
.set UART_tx__DR_SET, CYREG_GPIO_PRT3_DR_SET
.set UART_tx__INTCFG, CYREG_GPIO_PRT3_INTR_CFG
.set UART_tx__INTR, CYREG_GPIO_PRT3_INTR
.set UART_tx__INTR_CFG, CYREG_GPIO_PRT3_INTR_CFG
.set UART_tx__INTSTAT, CYREG_GPIO_PRT3_INTR
.set UART_tx__MASK, 0x02
.set UART_tx__PA__CFG0, CYREG_UDB_PA3_CFG0
.set UART_tx__PA__CFG1, CYREG_UDB_PA3_CFG1
.set UART_tx__PA__CFG10, CYREG_UDB_PA3_CFG10
.set UART_tx__PA__CFG11, CYREG_UDB_PA3_CFG11
.set UART_tx__PA__CFG12, CYREG_UDB_PA3_CFG12
.set UART_tx__PA__CFG13, CYREG_UDB_PA3_CFG13
.set UART_tx__PA__CFG14, CYREG_UDB_PA3_CFG14
.set UART_tx__PA__CFG2, CYREG_UDB_PA3_CFG2
.set UART_tx__PA__CFG3, CYREG_UDB_PA3_CFG3
.set UART_tx__PA__CFG4, CYREG_UDB_PA3_CFG4
.set UART_tx__PA__CFG5, CYREG_UDB_PA3_CFG5
.set UART_tx__PA__CFG6, CYREG_UDB_PA3_CFG6
.set UART_tx__PA__CFG7, CYREG_UDB_PA3_CFG7
.set UART_tx__PA__CFG8, CYREG_UDB_PA3_CFG8
.set UART_tx__PA__CFG9, CYREG_UDB_PA3_CFG9
.set UART_tx__PC, CYREG_GPIO_PRT3_PC
.set UART_tx__PC2, CYREG_GPIO_PRT3_PC2
.set UART_tx__PORT, 3
.set UART_tx__PS, CYREG_GPIO_PRT3_PS
.set UART_tx__SHIFT, 1

/* Wakeup_Interrupt */
.set Wakeup_Interrupt__INTC_CLR_EN_REG, CYREG_CM0_ICER
.set Wakeup_Interrupt__INTC_CLR_PD_REG, CYREG_CM0_ICPR
.set Wakeup_Interrupt__INTC_MASK, 0x01
.set Wakeup_Interrupt__INTC_NUMBER, 0
.set Wakeup_Interrupt__INTC_PRIOR_MASK, 0xC0
.set Wakeup_Interrupt__INTC_PRIOR_NUM, 3
.set Wakeup_Interrupt__INTC_PRIOR_REG, CYREG_CM0_IPR0
.set Wakeup_Interrupt__INTC_SET_EN_REG, CYREG_CM0_ISER
.set Wakeup_Interrupt__INTC_SET_PD_REG, CYREG_CM0_ISPR

/* Miscellaneous */
.set CYDEV_BCLK__HFCLK__HZ, 48000000
.set CYDEV_BCLK__HFCLK__KHZ, 48000
.set CYDEV_BCLK__HFCLK__MHZ, 48
.set CYDEV_BCLK__SYSCLK__HZ, 24000000
.set CYDEV_BCLK__SYSCLK__KHZ, 24000
.set CYDEV_BCLK__SYSCLK__MHZ, 24
.set CYDEV_BOOTLOADER_APPLICATIONS, 2
.set CYDEV_BOOTLOADER_CHECKSUM_BASIC, 0
.set CYDEV_BOOTLOADER_CHECKSUM_CRC, 1
.set CYDEV_BOOTLOADER_IO_COMP_CUSTOM_IO, 0
.set CyBtldr_Custom_Interface, CYDEV_BOOTLOADER_IO_COMP_CUSTOM_IO
.set CYDEV_BOOTLOADER_IO_COMP_CyBle, 2
.set CyBtldr_CyBle, CYDEV_BOOTLOADER_IO_COMP_CyBle
.set CYDEV_BOOTLOADER_IO_COMP, CYDEV_BOOTLOADER_IO_COMP_CyBle
.set CYDEV_BOOTLOADER_IO_COMP_LAUNCHER_ONLY, 1
.set CyBtldr_LAUNCHER_ONLY, CYDEV_BOOTLOADER_IO_COMP_LAUNCHER_ONLY
.set CYDEV_CHIP_DIE_LEOPARD, 1
.set CYDEV_CHIP_DIE_PSOC4A, 16
.set CYDEV_CHIP_DIE_PSOC5LP, 2
.set CYDEV_CHIP_DIE_PSOC5TM, 3
.set CYDEV_CHIP_DIE_TMA4, 4
.set CYDEV_CHIP_DIE_UNKNOWN, 0
.set CYDEV_CHIP_FAMILY_FM0P, 5
.set CYDEV_CHIP_FAMILY_FM3, 6
.set CYDEV_CHIP_FAMILY_FM4, 7
.set CYDEV_CHIP_FAMILY_PSOC3, 1
.set CYDEV_CHIP_FAMILY_PSOC4, 2
.set CYDEV_CHIP_FAMILY_PSOC5, 3
.set CYDEV_CHIP_FAMILY_PSOC6, 4
.set CYDEV_CHIP_FAMILY_UNKNOWN, 0
.set CYDEV_CHIP_FAMILY_USED, CYDEV_CHIP_FAMILY_PSOC4
.set CYDEV_CHIP_JTAG_ID, 0x135311A3
.set CYDEV_CHIP_MEMBER_3A, 1
.set CYDEV_CHIP_MEMBER_4A, 16
.set CYDEV_CHIP_MEMBER_4D, 12
.set CYDEV_CHIP_MEMBER_4E, 6
.set CYDEV_CHIP_MEMBER_4F, 17
.set CYDEV_CHIP_MEMBER_4G, 4
.set CYDEV_CHIP_MEMBER_4H, 15
.set CYDEV_CHIP_MEMBER_4I, 21
.set CYDEV_CHIP_MEMBER_4J, 13
.set CYDEV_CHIP_MEMBER_4K, 14
.set CYDEV_CHIP_MEMBER_4L, 20
.set CYDEV_CHIP_MEMBER_4M, 19
.set CYDEV_CHIP_MEMBER_4N, 9
.set CYDEV_CHIP_MEMBER_4O, 7
.set CYDEV_CHIP_MEMBER_4P, 18
.set CYDEV_CHIP_MEMBER_4Q, 11
.set CYDEV_CHIP_MEMBER_4R, 8
.set CYDEV_CHIP_MEMBER_4S, 10
.set CYDEV_CHIP_MEMBER_4U, 5
.set CYDEV_CHIP_MEMBER_5A, 3
.set CYDEV_CHIP_MEMBER_5B, 2
.set CYDEV_CHIP_MEMBER_6A, 22
.set CYDEV_CHIP_MEMBER_FM3, 26
.set CYDEV_CHIP_MEMBER_FM4, 27
.set CYDEV_CHIP_MEMBER_PDL_FM0P_TYPE1, 23
.set CYDEV_CHIP_MEMBER_PDL_FM0P_TYPE2, 24
.set CYDEV_CHIP_MEMBER_PDL_FM0P_TYPE3, 25
.set CYDEV_CHIP_MEMBER_UNKNOWN, 0
.set CYDEV_CHIP_MEMBER_USED, CYDEV_CHIP_MEMBER_4F
.set CYDEV_CHIP_DIE_EXPECT, CYDEV_CHIP_MEMBER_USED
.set CYDEV_CHIP_DIE_ACTUAL, CYDEV_CHIP_DIE_EXPECT
.set CYDEV_CHIP_REV_LEOPARD_ES1, 0
.set CYDEV_CHIP_REV_LEOPARD_ES2, 1
.set CYDEV_CHIP_REV_LEOPARD_ES3, 3
.set CYDEV_CHIP_REV_LEOPARD_PRODUCTION, 3
.set CYDEV_CHIP_REV_PSOC4A_ES0, 17
.set CYDEV_CHIP_REV_PSOC4A_PRODUCTION, 17
.set CYDEV_CHIP_REV_PSOC5LP_ES0, 0
.set CYDEV_CHIP_REV_PSOC5LP_PRODUCTION, 0
.set CYDEV_CHIP_REV_PSOC5TM_ES0, 0
.set CYDEV_CHIP_REV_PSOC5TM_ES1, 1
.set CYDEV_CHIP_REV_PSOC5TM_PRODUCTION, 1
.set CYDEV_CHIP_REV_TMA4_ES, 17
.set CYDEV_CHIP_REV_TMA4_ES2, 33
.set CYDEV_CHIP_REV_TMA4_PRODUCTION, 17
.set CYDEV_CHIP_REVISION_3A_ES1, 0
.set CYDEV_CHIP_REVISION_3A_ES2, 1
.set CYDEV_CHIP_REVISION_3A_ES3, 3
.set CYDEV_CHIP_REVISION_3A_PRODUCTION, 3
.set CYDEV_CHIP_REVISION_4A_ES0, 17
.set CYDEV_CHIP_REVISION_4A_PRODUCTION, 17
.set CYDEV_CHIP_REVISION_4D_PRODUCTION, 0
.set CYDEV_CHIP_REVISION_4E_PRODUCTION, 0
.set CYDEV_CHIP_REVISION_4F_PRODUCTION, 0
.set CYDEV_CHIP_REVISION_4F_PRODUCTION_256DMA, 0
.set CYDEV_CHIP_REVISION_4F_PRODUCTION_256K, 0
.set CYDEV_CHIP_REVISION_4G_ES, 17
.set CYDEV_CHIP_REVISION_4G_ES2, 33
.set CYDEV_CHIP_REVISION_4G_PRODUCTION, 17
.set CYDEV_CHIP_REVISION_4H_PRODUCTION, 0
.set CYDEV_CHIP_REVISION_4I_PRODUCTION, 0
.set CYDEV_CHIP_REVISION_4J_PRODUCTION, 0
.set CYDEV_CHIP_REVISION_4K_PRODUCTION, 0
.set CYDEV_CHIP_REVISION_4L_PRODUCTION, 0
.set CYDEV_CHIP_REVISION_4M_PRODUCTION, 0
.set CYDEV_CHIP_REVISION_4N_PRODUCTION, 0
.set CYDEV_CHIP_REVISION_4O_PRODUCTION, 0
.set CYDEV_CHIP_REVISION_4P_PRODUCTION, 0
.set CYDEV_CHIP_REVISION_4Q_PRODUCTION, 0
.set CYDEV_CHIP_REVISION_4R_PRODUCTION, 0
.set CYDEV_CHIP_REVISION_4S_PRODUCTION, 0
.set CYDEV_CHIP_REVISION_4U_PRODUCTION, 0
.set CYDEV_CHIP_REVISION_5A_ES0, 0
.set CYDEV_CHIP_REVISION_5A_ES1, 1
.set CYDEV_CHIP_REVISION_5A_PRODUCTION, 1
.set CYDEV_CHIP_REVISION_5B_ES0, 0
.set CYDEV_CHIP_REVISION_5B_PRODUCTION, 0
.set CYDEV_CHIP_REVISION_6A_NO_UDB, 0
.set CYDEV_CHIP_REVISION_6A_PRODUCTION, 0
.set CYDEV_CHIP_REVISION_FM3_PRODUCTION, 0
.set CYDEV_CHIP_REVISION_FM4_PRODUCTION, 0
.set CYDEV_CHIP_REVISION_PDL_FM0P_TYPE1_PRODUCTION, 0
.set CYDEV_CHIP_REVISION_PDL_FM0P_TYPE2_PRODUCTION, 0
.set CYDEV_CHIP_REVISION_PDL_FM0P_TYPE3_PRODUCTION, 0
.set CYDEV_CHIP_REVISION_USED, CYDEV_CHIP_REVISION_4F_PRODUCTION_256K
.set CYDEV_CHIP_REV_EXPECT, CYDEV_CHIP_REVISION_USED
.set CYDEV_CONFIG_READ_ACCELERATOR, 1
.set CYDEV_CONFIG_UNUSED_IO_AllowButWarn, 0
.set CYDEV_CONFIG_UNUSED_IO, CYDEV_CONFIG_UNUSED_IO_AllowButWarn
.set CYDEV_CONFIG_UNUSED_IO_AllowWithInfo, 1
.set CYDEV_CONFIG_UNUSED_IO_Disallowed, 2
.set CYDEV_CONFIGURATION_COMPRESSED, 1
.set CYDEV_CONFIGURATION_MODE_COMPRESSED, 0
.set CYDEV_CONFIGURATION_MODE, CYDEV_CONFIGURATION_MODE_COMPRESSED
.set CYDEV_CONFIGURATION_MODE_DMA, 2
.set CYDEV_CONFIGURATION_MODE_UNCOMPRESSED, 1
.set CYDEV_DEBUG_PROTECT_KILL, 4
.set CYDEV_DEBUG_PROTECT_OPEN, 1
.set CYDEV_DEBUG_PROTECT, CYDEV_DEBUG_PROTECT_OPEN
.set CYDEV_DEBUG_PROTECT_PROTECTED, 2
.set CYDEV_DEBUGGING_DPS_Disable, 3
.set CYDEV_DEBUGGING_DPS_SWD, 2
.set CYDEV_DEBUGGING_DPS, CYDEV_DEBUGGING_DPS_SWD
.set CYDEV_DEBUGGING_ENABLE, 1
.set CYDEV_DFT_SELECT_CLK0, 10
.set CYDEV_DFT_SELECT_CLK1, 11
.set CYDEV_HEAP_SIZE, 0x2500
.set CYDEV_IMO_TRIMMED_BY_USB, 0
.set CYDEV_IMO_TRIMMED_BY_WCO, 0
.set CYDEV_IS_EXPORTING_CODE, 1
.set CYDEV_IS_IMPORTING_CODE, 0
.set CYDEV_PROJ_TYPE, 4
.set CYDEV_PROJ_TYPE_BOOTLOADER, 1
.set CYDEV_PROJ_TYPE_LAUNCHER, 5
.set CYDEV_PROJ_TYPE_LOADABLE, 2
.set CYDEV_PROJ_TYPE_LOADABLEANDBOOTLOADER, 4
.set CYDEV_PROJ_TYPE_MULTIAPPBOOTLOADER, 3
.set CYDEV_PROJ_TYPE_STANDARD, 0
.set CYDEV_STACK_SIZE, 0x0800
.set CYDEV_USE_BUNDLED_CMSIS, 1
.set CYDEV_VARIABLE_VDDA, 1
.set CYDEV_VDD_MV, 3300
.set CYDEV_VDDA_MV, 3300
.set CYDEV_VDDR_MV, 3300
.set CYDEV_WDT_GENERATE_ISR, 1
.set CYIPBLOCK_m0s8bless_VERSION, 1
.set CYIPBLOCK_m0s8cpussv2_VERSION, 1
.set CYIPBLOCK_m0s8csd_VERSION, 1
.set CYIPBLOCK_m0s8ioss_VERSION, 1
.set CYIPBLOCK_m0s8lcd_VERSION, 2
.set CYIPBLOCK_m0s8lpcomp_VERSION, 2
.set CYIPBLOCK_m0s8peri_VERSION, 1
.set CYIPBLOCK_m0s8scb_VERSION, 2
.set CYIPBLOCK_m0s8srssv2_VERSION, 1
.set CYIPBLOCK_m0s8tcpwm_VERSION, 2
.set CYIPBLOCK_m0s8udbif_VERSION, 1
.set CYIPBLOCK_s8pass4al_VERSION, 1
.set CYDEV_BOOTLOADER_ENABLE, 1
.endif
